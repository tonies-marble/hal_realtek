## ameba/amebasmart/Kconfig
```kconfig
# Copyright (c) 2026 Realtek Semiconductor Corp.
# SPDX-License-Identifier: Apache-2.0

config ARM_CORE_CA32
	bool
	default y if SOC_RTL8730E_CA32

config ARM_CORE_CM4
	bool
	default y if SOC_RTL8730E_KM4
```
